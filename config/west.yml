## config/west.yml
```yaml
manifest:
  remotes:
    - name: zmkfirmware
      url-base: https://github.com/zmkfirmware
    - name: cornix-shield
      url-base: https://github.com/hitsmaxft
    - name: urob
      url-base: https://github.com/urob

  projects:
    - name: zmk
      remote: zmkfirmware
      import: app/west.yml
      revision: v0.3.0

    - name: zmk-keyboard-cornix
      remote: cornix-shield
      revision: main

    - name: zmk-helpers
      remote: urob
      revision: main

    - name: zmk-auto-layer
      remote: urob
      revision: main

    - name: zmk-tri-state
      remote: urob
      revision: main

  self:
    path: config
```
